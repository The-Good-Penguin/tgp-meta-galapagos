## conf/layer.conf
```bitbake
# We have a conf and classes directory, add to BBPATH
BBPATH .= ":${LAYERDIR}"

LAYERDEPENDS_meta-galapagos = "core"
LAYERSERIES_COMPAT_meta-galapagos = "dunfell kirkstone scarthgap"

GALAPAGOS_LAYERDIR := "${LAYERDIR}"
```
